## drivers/Kconfig
```kconfig
# Copyright (c) 2024 Laczen
# SPDX-License-Identifier: Apache-2.0

rsource "shared_info/Kconfig"
rsource "disk/Kconfig"
```

## drivers/disk/Kconfig
```kconfig
# Copyright (c) 2024 Laczen
# SPDX-License-Identifier: Apache-2.0

if DISK_DRIVERS

rsource "./Kconfig.eeprom"

endif #DISK_DRIVERS
```

## drivers/shared_info/Kconfig
```kconfig
# Copyright (c) 2024 Laczen
# SPDX-License-Identifier: Apache-2.0

menuconfig SHARED_INFO
	bool "Shared info driver"
	help
	  Enables support for the shared info driver.

if SHARED_INFO

config SHARED_INFO_INIT_PRIORITY
	int "Shared info devices init priority"
	default 40
	help
	  Shared info devices initialization priority,

module = SHARED_INFO
module-str = shared_info
source "subsys/logging/Kconfig.template.log_config"

endif # SHARED_INFO
```

## drivers/zephyr_shared_data/Kconfig
```kconfig
# Copyright (c) 2024 Laczen
# SPDX-License-Identifier: Apache-2.0

menuconfig ZEPHYR_SHARED_DATA
	bool "Zephyr shared data driver"
	help
	  Enables support for the zephyr shared data driver.

if ZEPHYR_SHARED_DATA

config ZEPHYR_SHARED_DATA_INIT_PRIORITY
	int "Shared data devices init priority"
	default 40
	help
	  Shared data devices initialization priority,

module = ZEPHYR_SHARED_DATA
module-str = zephyr_shared_data
source "subsys/logging/Kconfig.template.log_config"

endif # ZEPHYR_SHARED_DATA
```

## dts/bindings/disk/zephyr,eeprom-disk.yaml
```yaml
# Copyright (c) 2024 Laczen
# SPDX-License-Identifier: Apache-2.0

description: EEPROM disk

compatible: "zephyr,eeprom-disk"

include: base.yaml

properties:
  disk-name:
    type: string
    required: true
    description: |
      Disk name.

  sector-size:
    type: int
    required: true
    enum: [16, 32, 64, 128, 256, 512, 1024, 2048, 4096, 8192, 16384, 32768, 65536]
    description: |
      Disk sector size in bytes.

  eeprom:
    type: phandle
    required: true
    description: |
      phandle to the eeprom device that is used as disk.

  disk-size:
    type: int
    description: |
      Disk size in bytes.

  eeprom-offset:
    type: int
    description: |
      optional eeprom start offset in bytes.
```

## dts/bindings/zephyr,shared-data.yaml
```yaml
# Copyright (c) 2024 Laczen
# SPDX-License-Identifier: Apache-2.0

description: zephyr shared data area

compatible: "zephyr,shared-data"

include: base.yaml

properties:
  memory-region:
    type: phandle
    required: true
    description: |
      Memory region used to store data.
```

## subsys/Kconfig
```kconfig
# Copyright (c) 2024 Laczen
# SPDX-License-Identifier: Apache-2.0

rsource "storage/Kconfig"
rsource "settings/Kconfig"
```

## subsys/settings/Kconfig
```kconfig
# Copyright (c) 2024 Laczen
# SPDX-License-Identifier: Apache-2.0

if SETTINGS

config SETTINGS_STORAGE_AREA_STORE
	bool "Settings on storage area store"
	depends on STORAGE_AREA_STORE
	help
	  Enable support for settings on a storage area store.

endif #SETTINGS
```

## subsys/storage/storage_area/Kconfig
```kconfig
# Copyright (c) 2024 Laczen
# SPDX-License-Identifier: Apache-2.0

menuconfig STORAGE_AREA
	bool "Storage area subsystem"
	help
	  Enables support for the storage area subsystem.

if STORAGE_AREA

config STORAGE_AREA_FLASH
	bool "Storage area on flash"
	select FLASH
	help
	  Enable support for storage area on flash.

config STORAGE_AREA_EEPROM
	bool "Storage area on eeprom"
	help
	  Enable support for storage area on eeprom.

config STORAGE_AREA_DISK
	bool "Storage area on disk"
	help
	  Enable support for storage area on disk.

module = STORAGE_AREA
module-str = shared_info
source "subsys/logging/Kconfig.template.log_config"

endif # STORAGE_AREA
```

## zephyr/Kconfig
```kconfig
# Kconfig - zephyr_sharedram
#
# Copyright (c) 2022 Laczen
#
# SPDX-License-Identifier: Apache-2.0
#

config ZEPHYR_SHARED_DATA
	bool "Applications shared ram"
        default y if DT_HAS_ZEPHYR_SHARED_DATA_ENABLED
	help
	  Enable support of shared ram for applications.
```
