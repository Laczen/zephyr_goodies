## CMakeLists.txt
```
# Copyright (c) 2024 Laczen
# SPDX-License-Identifier: Apache-2.0

cmake_minimum_required(VERSION 3.20.0)

find_package(Zephyr REQUIRED HINTS $ENV{ZEPHYR_BASE})
project(zephyr_shared_data_test)

target_sources(app PRIVATE src/main.c)
```

## prj.conf
```kconfig
# Copyright (c) 2024 Laczen
# SPDX-License-Identifier: Apache-2.0
CONFIG_ZEPHYR_SHARED_DATA=y
CONFIG_ZTEST=y
CONFIG_LOG=y
#CONFIG_ZTEST_NEW_API=y
```

## boards/nrf52dk_nrf52832.overlay
```dts
/*
 * Copyright (c) 2023 Laczen
 * SPDX-License-Identifier: Apache-2.0
 */

#include <common/mem.h>

/ {
	sram_2000FF80: sram@2000FF80 {
		compatible = "zephyr,memory-region", "mmio-sram";
		reg = <0x2000FF80 0x80>;
                zephyr,memory-region = "Retention";
                status = "okay";
        };

        shared_data: shared_data {
                compatible = "zephyr,shared-data";
                memory-region = <&sram_2000FF80>;
                status = "okay";
        };

        aliases {
                shareddatatestdevice = &shared_data;
        };

};
```

## boards/qemu_cortex_m3.overlay
```dts
/*
 * Copyright (c) 2023 Laczen
 * SPDX-License-Identifier: Apache-2.0
 */

#include <common/mem.h>

/ {
	sram_2000FC00: sram@2000FC00 {
		compatible = "zephyr,memory-region", "mmio-sram";
		reg = <0x2000FC00 0x400>;
                zephyr,memory-region = "Retention";
                status = "okay";
        };

        shared_data: shared_data {
                compatible = "zephyr,shared-data";
                status = "okay";
        };

        aliases {
                shareddatatestdevice = &shared_data;
        };

};
```

## src/main.c
```c
/*
 * Copyright (c) 2024 Laczen
 * SPDX-License-Identifier: Apache-2.0
 */

#include <string.h>
#include <zephyr/kernel.h>
#include <zephyr/ztest.h>
#include <zephyr/devicetree.h>
#include <zephyr/drivers/zephyr_shared_data.h>

const static struct device *shareddatatestdevice =
	DEVICE_DT_GET(DT_ALIAS(shareddatatestdevice));

static void *shared_data_api_setup(void)
{
	if (IS_ENABLED(CONFIG_USERSPACE)) {
		k_object_access_grant(shareddatatestdevice, k_current_get());
	}

	return NULL;
}

ZTEST_USER(shared_data_api, test_get_size)
{
	int rc;
	size_t size = 0U;

	rc = zephyr_shared_data_size(shareddatatestdevice, &size);

	zassert_equal(rc, 0, "Get size returned invalid value [%d]", rc);
	zassert_not_equal(size, 0U, "Size value is invalid");
}

ZTEST_USER(shared_data_api, test_get_set)
{
	int rc;
	size_t size = 0U;

	rc = zephyr_shared_data_size(shareddatatestdevice, &size);

	zassert_equal(rc, 0, "Get size returned invalid value [%d]", rc);
	zassert_not_equal(size, 0U, "Size value is invalid");

	uint8_t wr[size];
	uint8_t rd[size];

	memset(wr, 'T', sizeof(wr));
	memset(rd, 0, sizeof(rd));

	rc = zephyr_shared_data_prog(shareddatatestdevice, 0U, wr, sizeof(wr));
	zassert_equal(rc, 0, "prog returned [%d]", rc);

	rc = zephyr_shared_data_read(shareddatatestdevice, 0U, rd, sizeof(rd));
	zassert_equal(rc, 0, "read returned [%d]", rc);

	zassert_equal(memcmp(rd, wr, sizeof(wr)), 0, "data mismatch");
}

ZTEST_SUITE(shared_data_api, NULL, shared_data_api_setup, NULL, NULL, NULL);
```
