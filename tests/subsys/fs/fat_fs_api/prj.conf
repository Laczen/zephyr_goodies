## prj.conf
```kconfig
CONFIG_FILE_SYSTEM=y
CONFIG_LOG=y
CONFIG_FILE_SYSTEM=y
CONFIG_FILE_SYSTEM_MKFS=y
CONFIG_FAT_FILESYSTEM_ELM=y
CONFIG_DISK_ACCESS=y
CONFIG_DISK_DRIVER_EEPROM=y
CONFIG_ZTEST=y
```

## boards/native_sim.overlay
```dts
/*
 * Copyright (c) 2022 Nordic Semiconductor ASA
 *
 * SPDX-License-Identifier: Apache-2.0
 */

/delete-node/ &eeprom0;

/ {
	eeprom0: eeprom {
		status = "okay";
		compatible = "zephyr,sim-eeprom";
		/* There seems to be some internal fatfs minimum for the size
		 * of the disk, anything smaller than 64kB does not work
		 */
		size = <DT_SIZE_K(64)>;
	};

	test_disk: storage_disk {
		compatible = "zephyr,eeprom-disk";
		/* Only a limited number of names are supported by zephyr fatfs
		 * "RAM","NAND","CF","SD","SD2","USB","USB2","USB3"
		 */
		disk-name = "RAM";
		sector-size = <512>;
		eeprom = <&eeprom0>;
		/* eeprom-offset = <0>; optional offset on eeprom */
		/* disk-size = <DT_SIZE_K(16)>; optional disk size */
	};

};
```

## src/main.c
```c
/*
 * Copyright (c) 2016 Intel Corporation.
 * Copyright (c) 2023 Husqvarna AB
 *
 * SPDX-License-Identifier: Apache-2.0
 */

#include "test_fat.h"
void test_fs_open_flags(void);
const char *test_fs_open_flags_file_path = FATFS_MNTP "/the_file.txt";

static void *fat_fs_basic_setup(void)
{
	fs_file_t_init(&filep);
	test_fat_mount();
	test_fat_file();
	test_fat_dir();
	test_fat_fs();
	test_fat_rename();
	test_fs_open_flags();
#ifdef CONFIG_FS_FATFS_REENTRANT
	test_fat_file_reentrant();
#endif /* CONFIG_FS_FATFS_REENTRANT */
	test_fat_unmount();

	return NULL;
}
ZTEST_SUITE(fat_fs_basic, NULL, fat_fs_basic_setup, NULL, NULL, NULL);
```

## src/test_fat.h
```c
/*
 * Copyright (c) 2016 Intel Corporation.
 * Copyright (c) 2020 Nordic Semiconductor ASA
 * Copyright (c) 2023 Husqvarna AB
 *
 * SPDX-License-Identifier: Apache-2.0
 */

#include <zephyr/kernel.h>
#include <zephyr/ztest.h>
#include <zephyr/fs/fs.h>
#include <ff.h>

#ifdef CONFIG_DISK_DRIVER_RAM
#define DISK_NAME "RAM"
#elif defined(CONFIG_DISK_DRIVER_FLASH)
#define DISK_NAME DT_PROP(DT_NODELABEL(test_disk), disk_name)
#elif defined(CONFIG_DISK_DRIVER_EEPROM)
#define DISK_NAME DT_PROP(DT_NODELABEL(test_disk), disk_name)
#elif defined(CONFIG_DISK_DRIVER_SDMMC)
#define DISK_NAME CONFIG_SDMMC_VOLUME_NAME
#elif defined(CONFIG_DISK_DRIVER_MMC)
#define DISK_NAME CONFIG_MMC_VOLUME_NAME
#else
#error "Failed to select DISK access type"
#endif

#define FATFS_MNTP "/" DISK_NAME ":"
#if defined(CONFIG_FS_FATFS_LFN)
#define TEST_FILE                                                               \
	FATFS_MNTP                                                              \
	"/testlongfilenamethatsmuchlongerthan8.3chars.text"
#else
#define TEST_FILE FATFS_MNTP "/testfile.txt"
#endif /* CONFIG_FS_FATFS_LFN */
#define TEST_DIR      FATFS_MNTP "/testdir"
#define TEST_DIR_FILE FATFS_MNTP "/testdir/testfile.txt"

extern struct fs_file_t filep;
extern const char test_str[];
/* FatFs work area */
extern FATFS fat_fs;

int check_file_dir_exists(const char *path);

void test_fat_mount(void);
void test_fat_unmount(void);
void test_fat_file(void);
void test_fat_dir(void);
void test_fat_fs(void);
void test_fat_rename(void);
#ifdef CONFIG_FS_FATFS_REENTRANT
void test_fat_file_reentrant(void);
#endif /* CONFIG_FS_FATFS_REENTRANT */
```
